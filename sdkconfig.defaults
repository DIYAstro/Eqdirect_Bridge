## sdkconfig.defaults
```kconfig
# BT Controller: Classic BT only, no BLE
CONFIG_BTDM_CTRL_MODE_BR_EDR_ONLY=y
CONFIG_BTDM_CTRL_BLE_MAX_CONN=0
CONFIG_BTDM_CTRL_BR_EDR_MAX_ACL_CONN=2
CONFIG_BTDM_CTRL_BR_EDR_MAX_SYNC_CONN=0

# Bluedroid: disable everything except SPP
CONFIG_BT_CLASSIC_ENABLED=y
CONFIG_BT_BLUEDROID_ENABLED=y
CONFIG_BT_SPP_ENABLED=y
CONFIG_BT_BLE_ENABLED=n
CONFIG_BT_HFP_ENABLE=n
CONFIG_BT_A2DP_ENABLE=n
CONFIG_BT_AVRC_ENABLE=n
CONFIG_BT_OPP_ENABLED=n
```
